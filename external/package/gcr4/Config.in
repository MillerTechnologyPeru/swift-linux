## external/package/gcr4/Config.in
```kconfig
config BR2_PACKAGE_GCR4
	bool "gcr4"
	depends on BR2_USE_WCHAR # libglib2
	depends on BR2_TOOLCHAIN_HAS_THREADS # libglib2
	depends on BR2_USE_MMU # libglib2
	depends on !BR2_STATIC_LIBS
	select BR2_PACKAGE_LIBGLIB2
	select BR2_PACKAGE_P11_KIT
	select BR2_PACKAGE_LIBGCRYPT
	help
	  GCR 4: certificate/key handling and secure prompting
	  libraries; gnome-shell and evolution-data-server link the
	  GTK-less core.

	  https://gitlab.gnome.org/GNOME/gcr
```

## external/package/geoclue2/Config.in
```kconfig
config BR2_PACKAGE_GEOCLUE2
	bool "geoclue2"
	depends on BR2_USE_WCHAR # libglib2
	depends on BR2_TOOLCHAIN_HAS_THREADS # libglib2
	depends on BR2_USE_MMU # libglib2
	select BR2_PACKAGE_LIBGLIB2
	select BR2_PACKAGE_JSON_GLIB
	select BR2_PACKAGE_LIBSOUP3
	help
	  Geolocation D-Bus service (WiFi positioning); the control
	  center and calendar/weather consumers use it.

	  https://gitlab.freedesktop.org/geoclue/geoclue
```

## external/package/geocode-glib/Config.in
```kconfig
config BR2_PACKAGE_GEOCODE_GLIB
	bool "geocode-glib"
	depends on BR2_USE_MMU
	select BR2_PACKAGE_LIBSOUP3
	select BR2_PACKAGE_JSON_GLIB
	help
	  Geocoding/reverse-geocoding client library (nominatim);
	  gnome-settings-daemon and libgweather consumers use it.

	  https://gitlab.gnome.org/GNOME/geocode-glib
```

## external/package/gexiv2/Config.in
```kconfig
config BR2_PACKAGE_GEXIV2
	bool "gexiv2"
	depends on BR2_INSTALL_LIBSTDCPP # exiv2
	select BR2_PACKAGE_EXIV2
	help
	  GObject wrapper around exiv2 (image metadata); nautilus reads
	  EXIF through it.

	  https://gitlab.gnome.org/GNOME/gexiv2
```

## external/package/gjs/Config.in
```kconfig
config BR2_PACKAGE_GJS
	bool "gjs"
	depends on BR2_PACKAGE_MOZJS128
	select BR2_PACKAGE_GOBJECT_INTROSPECTION
	select BR2_PACKAGE_CAIRO
	help
	  GNOME's JavaScript bindings: SpiderMonkey plus GObject
	  introspection. gnome-shell's UI is gjs code; the typelibs the
	  rest of the stack installs are what it calls into.

	  https://gitlab.gnome.org/GNOME/gjs
```

## external/package/gl4es/Config.in
```kconfig
config BR2_PACKAGE_GL4ES
	bool "gl4es"
	depends on !BR2_STATIC_LIBS
	help
	  gl4es implements desktop OpenGL 1.5 (and much of 2.1) on top
	  of OpenGL ES 1.1/2.0, so legacy GL games and apps run on
	  GPUs whose drivers only expose GLES - Mali, older Adreno and
	  friends.

	  It installs to /usr/lib/gl4es so it never shadows a real
	  libGL: programs opt in with
	  LD_LIBRARY_PATH=/usr/lib/gl4es.

	  https://github.com/ptitSeb/gl4es

comment "gl4es needs a toolchain with dynamic libraries"
	depends on BR2_STATIC_LIBS
```

## external/package/glslang/Config.in
```kconfig
config BR2_PACKAGE_GLSLANG
	bool "glslang"
	depends on BR2_INSTALL_LIBSTDCPP
	depends on !BR2_STATIC_LIBS
	select BR2_PACKAGE_SPIRV_TOOLS
	select BR2_PACKAGE_SPIRV_HEADERS
	help
	  Khronos reference GLSL/HLSL front end: compiles shader source
	  to SPIR-V. shaderc wraps it; Vulkan consumers compile their
	  shaders through the pair at runtime.

	  https://github.com/KhronosGroup/glslang
```

## external/package/gmenu2x/Config.in
```kconfig
config BR2_PACKAGE_GMENU2X
	bool "gmenu2x"
	depends on BR2_INSTALL_LIBSTDCPP
	depends on BR2_USE_MMU
	select BR2_PACKAGE_SDL
	select BR2_PACKAGE_SDL_IMAGE
	select BR2_PACKAGE_SDL_TTF
	help
	  Game/app launcher for small framebuffer handhelds: SDL 1.2,
	  no GPU, no Wayland and no OpenGL required. This is MiyooCFW's
	  maintained fork, the frontend of the BittBoy/PocketGo family
	  of armv5 devices.

	  https://github.com/MiyooCFW/gmenu2x
```

## external/package/gnome-autoar/Config.in
```kconfig
config BR2_PACKAGE_GNOME_AUTOAR
	bool "gnome-autoar"
	depends on BR2_USE_WCHAR # libglib2
	depends on BR2_TOOLCHAIN_HAS_THREADS # libglib2
	depends on BR2_USE_MMU # libglib2
	select BR2_PACKAGE_LIBGLIB2
	select BR2_PACKAGE_LIBARCHIVE
	help
	  Archive extract/compress helper library; nautilus uses it for
	  its archive operations.

	  https://gitlab.gnome.org/GNOME/gnome-autoar
```

## external/package/gnome-bluetooth/Config.in
```kconfig
config BR2_PACKAGE_GNOME_BLUETOOTH
	bool "gnome-bluetooth"
	depends on BR2_PACKAGE_LIBGTK4
	select BR2_PACKAGE_LIBADWAITA
	select BR2_PACKAGE_GSOUND
	select BR2_PACKAGE_LIBNOTIFY
	select BR2_PACKAGE_LIBGUDEV
	help
	  Bluetooth settings library and widgets over BlueZ; the control
	  center's bluetooth panel is built on it.

	  https://gitlab.gnome.org/GNOME/gnome-bluetooth
```

## external/package/gnome-calculator/Config.in
```kconfig
config BR2_PACKAGE_GNOME_CALCULATOR
	bool "gnome-calculator"
	depends on BR2_PACKAGE_LIBGTK4
	select BR2_PACKAGE_LIBADWAITA
	select BR2_PACKAGE_GTKSOURCEVIEW5
	select BR2_PACKAGE_LIBGEE
	select BR2_PACKAGE_MPFR
	select BR2_PACKAGE_GMP
	select BR2_PACKAGE_LIBSOUP3 # currency rates
	help
	  Calculator, written in Vala; currency conversion pulls rates
	  over libsoup.

	  https://apps.gnome.org/Calculator/
```

## external/package/gnome-calendar/Config.in
```kconfig
config BR2_PACKAGE_GNOME_CALENDAR
	bool "gnome-calendar"
	depends on BR2_PACKAGE_LIBGTK4
	select BR2_PACKAGE_LIBADWAITA
	select BR2_PACKAGE_EVOLUTION_DATA_SERVER
	select BR2_PACKAGE_LIBGWEATHER
	select BR2_PACKAGE_GEOCODE_GLIB
	select BR2_PACKAGE_GEOCLUE2
	help
	  Calendar, storing its events through evolution-data-server.

	  https://apps.gnome.org/Calendar/
```

## external/package/gnome-console/Config.in
```kconfig
config BR2_PACKAGE_GNOME_CONSOLE
	bool "gnome-console"
	depends on BR2_PACKAGE_LIBGTK4
	select BR2_PACKAGE_LIBADWAITA
	select BR2_PACKAGE_VTE4
	select BR2_PACKAGE_LIBGTOP
	help
	  Console (kgx), the GNOME terminal for GTK 4.

	  https://apps.gnome.org/Console/
```

## external/package/gnome-control-center/Config.in
```kconfig
config BR2_PACKAGE_GNOME_CONTROL_CENTER
	bool "gnome-control-center"
	depends on BR2_PACKAGE_LIBGTK4
	select BR2_PACKAGE_LIBADWAITA
	select BR2_PACKAGE_ACCOUNTSSERVICE
	select BR2_PACKAGE_COLORD_GTK
	select BR2_PACKAGE_CUPS
	select BR2_PACKAGE_GNOME_BLUETOOTH
	select BR2_PACKAGE_GNOME_ONLINE_ACCOUNTS
	select BR2_PACKAGE_GSOUND
	select BR2_PACKAGE_LIBGTOP
	select BR2_PACKAGE_LIBNMA
	select BR2_PACKAGE_LIBPWQUALITY
	select BR2_PACKAGE_MODEM_MANAGER
	select BR2_PACKAGE_UDISKS2
	select BR2_PACKAGE_LIBKRB5
	help
	  Settings (gnome-control-center). The heaviest app of the set:
	  its panels hard-require cups, NetworkManager/libnma,
	  ModemManager, accountsservice, online-accounts and udisks -
	  note the image manages network with NetworkManager; the
	  network panel drives NetworkManager instead.

	  https://apps.gnome.org/Settings/
```

## external/package/gnome-desktop/Config.in
```kconfig
config BR2_PACKAGE_GNOME_DESKTOP
	bool "gnome-desktop"
	depends on BR2_PACKAGE_LIBGTK4
	select BR2_PACKAGE_ISO_CODES
	select BR2_PACKAGE_LIBSECCOMP
	select BR2_PACKAGE_GSETTINGS_DESKTOP_SCHEMAS
	select BR2_PACKAGE_XKEYBOARD_CONFIG
	help
	  gnome-desktop-4: shared helpers (languages, wallpaper,
	  thumbnails, xkb info) for gnome-shell and the settings daemon.

	  https://gitlab.gnome.org/GNOME/gnome-desktop
```

## external/package/gnome-disk-utility/Config.in
```kconfig
config BR2_PACKAGE_GNOME_DISK_UTILITY
	bool "gnome-disk-utility"
	depends on BR2_PACKAGE_LIBGTK4
	select BR2_PACKAGE_LIBADWAITA
	select BR2_PACKAGE_UDISKS2
	select BR2_PACKAGE_LIBPWQUALITY
	select BR2_PACKAGE_LIBSECRET
	select BR2_PACKAGE_LIBDVDREAD
	help
	  Disks, the UI over udisks: partitions, formatting, SMART,
	  images.

	  https://apps.gnome.org/DiskUtility/
```

## external/package/gnome-online-accounts/Config.in
```kconfig
config BR2_PACKAGE_GNOME_ONLINE_ACCOUNTS
	bool "gnome-online-accounts"
	depends on BR2_PACKAGE_LIBGTK4
	depends on BR2_PACKAGE_WEBKITGTK # provider login UIs
	select BR2_PACKAGE_LIBADWAITA
	select BR2_PACKAGE_LIBREST
	select BR2_PACKAGE_LIBSECRET
	select BR2_PACKAGE_GCR4
	help
	  Online-accounts D-Bus service and backend library; the control
	  center's accounts panel requires the backend, which needs
	  webkitgtk (GTK 4 API) for provider sign-in.

	  https://gitlab.gnome.org/GNOME/gnome-online-accounts
```

## external/package/gnome-session/Config.in
```kconfig
config BR2_PACKAGE_GNOME_SESSION
	bool "gnome-session"
	depends on BR2_PACKAGE_MUTTER
	select BR2_PACKAGE_UPOWER
	select BR2_PACKAGE_JSON_GLIB
	help
	  The GNOME session manager, built with its builtin (non-
	  systemd) session startup - the arrangement Gentoo ships on
	  OpenRC.

	  https://gitlab.gnome.org/GNOME/gnome-session
```

## external/package/gnome-settings-daemon/Config.in
```kconfig
config BR2_PACKAGE_GNOME_SETTINGS_DAEMON
	bool "gnome-settings-daemon"
	depends on BR2_PACKAGE_MUTTER
	select BR2_PACKAGE_COLORD
	select BR2_PACKAGE_LIBGWEATHER
	select BR2_PACKAGE_GEOCODE_GLIB
	select BR2_PACKAGE_GNOME_DESKTOP
	select BR2_PACKAGE_LIBNOTIFY
	select BR2_PACKAGE_LIBWACOM
	select BR2_PACKAGE_UPOWER
	select BR2_PACKAGE_POLKIT
	select BR2_PACKAGE_PULSEAUDIO # libpulse for volume control (gvc)
	help
	  The GNOME settings daemons (xsettings, power, media keys,
	  color, keyboard...); gnome-session starts them.

	  https://gitlab.gnome.org/GNOME/gnome-settings-daemon
```

## external/package/gnome-shell/Config.in
```kconfig
config BR2_PACKAGE_GNOME_SHELL
	bool "gnome-shell"
	depends on BR2_PACKAGE_MUTTER
	depends on BR2_PACKAGE_GJS
	select BR2_PACKAGE_GNOME_DESKTOP
	select BR2_PACKAGE_GCR4
	select BR2_PACKAGE_EVOLUTION_DATA_SERVER
	select BR2_PACKAGE_IBUS
	select BR2_PACKAGE_POLKIT
	select BR2_PACKAGE_NETWORK_MANAGER
	select BR2_PACKAGE_LIBSECRET
	select BR2_PACKAGE_GNOME_SETTINGS_DAEMON # runtime
	select BR2_PACKAGE_GNOME_SESSION # runtime
	select BR2_PACKAGE_ADWAITA_ICON_THEME # runtime
	help
	  The GNOME desktop shell, running as a mutter plugin with its
	  UI in gjs, with the NetworkManager indicator built in (GNOME
	  images use NetworkManager, as every image now does).

	  https://gitlab.gnome.org/GNOME/gnome-shell
```

## external/package/gnome-software/Config.in
```kconfig
config BR2_PACKAGE_GNOME_SOFTWARE
	bool "gnome-software"
	depends on BR2_PACKAGE_LIBGTK4
	depends on BR2_PACKAGE_FLATPAK
	select BR2_PACKAGE_LIBADWAITA
	select BR2_PACKAGE_APPSTREAM
	select BR2_PACKAGE_LIBXMLB
	select BR2_PACKAGE_JSON_GLIB
	select BR2_PACKAGE_LIBSOUP3
	select BR2_PACKAGE_GSETTINGS_DESKTOP_SCHEMAS
	select BR2_PACKAGE_ISO_CODES
	help
	  GNOME Software: the desktop application store. Built with
	  the Flatpak backend only - there is no distro package
	  manager on a read-only image, so Flatpak IS the way
	  applications arrive, and this is its storefront.

	  https://apps.gnome.org/Software

comment "gnome-software needs gtk4 and flatpak"
	depends on !BR2_PACKAGE_LIBGTK4 || !BR2_PACKAGE_FLATPAK
```

## external/package/grim/Config.in
```kconfig
config BR2_PACKAGE_GRIM
	bool "grim"
	depends on BR2_PACKAGE_WAYLAND
	select BR2_PACKAGE_LIBPNG
	select BR2_PACKAGE_PIXMAN
	help
	  Screenshot utility for wlroots-based Wayland compositors (sway).
	  Captures the whole output, a region (-g) or a single window, using
	  the wlr-screencopy protocol.

	  https://gitlab.freedesktop.org/emersion/grim

comment "grim needs wayland"
	depends on !BR2_PACKAGE_WAYLAND
```

## external/package/gsound/Config.in
```kconfig
config BR2_PACKAGE_GSOUND
	bool "gsound"
	depends on BR2_USE_WCHAR # libglib2
	depends on BR2_TOOLCHAIN_HAS_THREADS # libglib2
	depends on BR2_USE_MMU # libglib2
	select BR2_PACKAGE_LIBGLIB2
	select BR2_PACKAGE_LIBCANBERRA
	help
	  Small GObject wrapper over libcanberra; gnome-bluetooth and the
	  control center play their event sounds through it.

	  https://gitlab.gnome.org/GNOME/gsound
```

## external/package/gtk4/Config.in
```kconfig
config BR2_PACKAGE_GTK4
	bool "gtk4"
	depends on BR2_INSTALL_LIBSTDCPP # harfbuzz via pango
	depends on BR2_TOOLCHAIN_HAS_THREADS # libglib2
	depends on BR2_USE_WCHAR # libglib2
	depends on BR2_USE_MMU # libglib2
	depends on !BR2_STATIC_LIBS
	depends on BR2_PACKAGE_HAS_LIBGL || BR2_PACKAGE_HAS_LIBGLES
	select BR2_PACKAGE_LIBGLIB2
	select BR2_PACKAGE_CAIRO
	select BR2_PACKAGE_CAIRO_PNG
	select BR2_PACKAGE_PANGO
	select BR2_PACKAGE_GDK_PIXBUF
	select BR2_PACKAGE_GRAPHENE
	select BR2_PACKAGE_LIBEPOXY
	select BR2_PACKAGE_FONTCONFIG
	help
	  GTK 4, the current major version of the GTK toolkit; the
	  GNOME stack (libadwaita and the core applications) builds on
	  it. Backends are sub-options below.

	  https://www.gtk.org

if BR2_PACKAGE_GTK4

config BR2_PACKAGE_GTK4_WAYLAND
	bool "Wayland GDK backend"
	default y
	depends on BR2_PACKAGE_WAYLAND
	select BR2_PACKAGE_WAYLAND_PROTOCOLS
	select BR2_PACKAGE_LIBXKBCOMMON

config BR2_PACKAGE_GTK4_X11
	bool "X11 GDK backend"
	default y
	depends on BR2_PACKAGE_XORG7
	select BR2_PACKAGE_XLIB_LIBX11
	select BR2_PACKAGE_XLIB_LIBXEXT
	select BR2_PACKAGE_XLIB_LIBXRANDR
	select BR2_PACKAGE_XLIB_LIBXRENDER
	select BR2_PACKAGE_XLIB_LIBXI
	select BR2_PACKAGE_XLIB_LIBXCURSOR
	select BR2_PACKAGE_XLIB_LIBXDAMAGE
	select BR2_PACKAGE_XLIB_LIBXFIXES
	select BR2_PACKAGE_XLIB_LIBXINERAMA

endif
```

## external/package/gtksourceview5/Config.in
```kconfig
config BR2_PACKAGE_GTKSOURCEVIEW5
	bool "gtksourceview5"
	depends on BR2_PACKAGE_LIBGTK4
	select BR2_PACKAGE_PCRE2
	help
	  Source-code editing widget for GTK 4; gnome-calculator's
	  equation entry uses it.

	  https://gitlab.gnome.org/GNOME/gtksourceview
```
