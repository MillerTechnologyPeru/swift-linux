## external/package/firmware-trogdor-modem-lte/Config.in
```kconfig
config BR2_PACKAGE_FIRMWARE_TROGDOR_MODEM_LTE
	bool "firmware-trogdor-modem-lte"
	help
	  Firmware for the modem of Qualcomm SC7180 (trogdor) Chromebooks
	  with LTE: mba.mbn and qdsp6sw.mbn under qcom/sc7180-trogdor/modem,
	  which the LTE SKUs' device trees name instead of modem-nolte. A
	  package of its own because its files share their names with the
	  non-LTE build's. ChromeOS's build, taken from Cadmium's firmware
	  collection.

	  https://github.com/CadmiumLinux/firmware
```

## external/package/firmware-trogdor-modem/Config.in
```kconfig
config BR2_PACKAGE_FIRMWARE_TROGDOR_MODEM
	bool "firmware-trogdor-modem"
	help
	  Firmware for the modem of Qualcomm SC7180 (trogdor) Chromebooks
	  without LTE: mba.mbn and qdsp6sw.mbn under
	  qcom/sc7180-trogdor/modem-nolte, as the trogdor device tree names
	  them. The modem hosts the Wi-Fi's firmware service, so without it
	  there is no Wi-Fi. ChromeOS's build, which linux-firmware does not
	  carry; taken from Cadmium's firmware collection.

	  https://github.com/CadmiumLinux/firmware
```

## external/package/hfsutils/Config.in
```kconfig
config BR2_PACKAGE_HFSUTILS
	bool "hfsutils"
	help
	  Tools for HFS volumes, the file system Open Firmware on
	  PowerPC Macs boots from: hformat, hmount, hcopy, hattrib
	  and the rest, which work on a volume without mounting it,
	  so the system can update its own boot partition.

	  https://www.mars.org/home/rob/proj/hfs/
```

## external/package/hfsutils/Config.in.host
```kconfig
config BR2_PACKAGE_HOST_HFSUTILS
	bool "host hfsutils"
	help
	  Tools for HFS volumes, the file system Open Firmware on
	  PowerPC Macs boots from: hformat makes one in a file, and
	  hcopy, hattrib and hmkdir fill it, set Mac file types and
	  bless its boot folder, without mounting anything.

	  https://www.mars.org/home/rob/proj/hfs/
```

## external/package/rk3326-loader/Config.in
```kconfig
config BR2_PACKAGE_RK3326_LOADER
	bool "rk3326-loader"
	depends on BR2_TARGET_UBOOT
	depends on BR2_HOSTARCH = "x86_64"
	select BR2_PACKAGE_HOST_UBOOT_TOOLS
	help
	  Boot image for Rockchip RK3326 (PX30) handhelds: Rockchip's
	  DDR init and miniloader as the idbloader, U-Boot packed as
	  uboot.img, and the BL31 trust image, laid out as one file to
	  write at sector 64 of the boot medium. Mainline U-Boot cannot
	  pack its own second-stage loader for this SoC, so the vendor
	  loader chain from rkbin is used, as the upstream handheld
	  distributions do.

	  The rkbin packing tools are prebuilt x86_64 binaries, hence
	  the host restriction.

	  https://github.com/rockchip-linux/rkbin

comment "rk3326-loader needs U-Boot and an x86_64 build host"
	depends on !BR2_TARGET_UBOOT || BR2_HOSTARCH != "x86_64"
```

## external/package/rk3566-loader/Config.in
```kconfig
config BR2_PACKAGE_RK3566_LOADER
	bool "rk3566-loader"
	depends on BR2_TARGET_UBOOT
	select BR2_PACKAGE_HOST_UBOOT_TOOLS
	help
	  Boot image for Rockchip RK3566 handhelds: Rockchip's DDR init
	  and U-Boot's SPL as the idbloader, then U-Boot's u-boot.itb,
	  laid out as one file to write at sector 64 of the boot medium.
	  The DDR init comes from rkbin at the commit the upstream
	  handheld distributions pin; U-Boot itself is mainline.

	  Needs U-Boot built with the SPL and u-boot.itb installed
	  (BR2_TARGET_UBOOT_SPL, BR2_TARGET_UBOOT_FORMAT_ITB).

	  https://github.com/rockchip-linux/rkbin

comment "rk3566-loader needs U-Boot"
	depends on !BR2_TARGET_UBOOT
```

## external/package/rocknix-joypad/Config.in
```kconfig
config BR2_PACKAGE_ROCKNIX_JOYPAD
	bool "rocknix-joypad"
	depends on BR2_LINUX_KERNEL
	help
	  Out-of-tree input drivers for the gamepad controls of the
	  Rockchip handhelds: rocknix-joypad (multi-ADC sticks) and
	  rocknix-singleadc-joypad (one ADC multiplexed across the
	  sticks, as on the Game Console R36S and its clones). The
	  device tree picks the driver by compatible string; both are
	  built, and the kernel loads whichever matches.

	  https://github.com/ROCKNIX/rocknix-joypad

comment "rocknix-joypad needs a Linux kernel to be built"
	depends on !BR2_LINUX_KERNEL
```
