## external/package/ibus/Config.in
```kconfig
config BR2_PACKAGE_IBUS
	bool "ibus"
	depends on BR2_USE_WCHAR # libglib2
	depends on BR2_TOOLCHAIN_HAS_THREADS # libglib2
	depends on BR2_USE_MMU # libglib2
	depends on !BR2_STATIC_LIBS
	select BR2_PACKAGE_LIBGLIB2
	select BR2_PACKAGE_DCONF
	help
	  Input method framework; gnome-shell links libibus at build
	  time (the shell is ibus's UI on GNOME).

	  https://github.com/ibus/ibus
```

## external/package/image-storage/Config.in
```kconfig
config BR2_PACKAGE_IMAGE_STORAGE
	bool "image-storage"
	help
	  No upstream, no install content - this package exists only to
	  carry LINUX_CONFIG_FIXUPS for the filesystems the image's own
	  storage needs the kernel to support: EROFS for the read-only
	  root slot, and ext4 plus f2fs for the data partition (S15data
	  and system-install can format it as either). Board kernel
	  defconfigs do not carry these; ext4 tends to be on already,
	  EROFS and f2fs generally are not.

	  Enabled unconditionally by the image profile - every image
	  needs its root and data filesystems to actually mount.
```

## external/package/iso-codes/Config.in
```kconfig
config BR2_PACKAGE_ISO_CODES
	bool "iso-codes"
	help
	  ISO language/country/currency name lists with translations;
	  gnome-desktop's language support reads them.

	  https://salsa.debian.org/iso-codes-team/iso-codes
```

## external/package/libadwaita/Config.in
```kconfig
config BR2_PACKAGE_LIBADWAITA
	bool "libadwaita"
	depends on BR2_PACKAGE_LIBGTK4
	select BR2_PACKAGE_APPSTREAM
	help
	  Building blocks and the Adwaita style for modern GNOME
	  applications, on top of GTK 4.

	  https://gitlab.gnome.org/GNOME/libadwaita
```

## external/package/libei/Config.in
```kconfig
config BR2_PACKAGE_LIBEI
	bool "libei"
	depends on BR2_USE_MMU
	select BR2_PACKAGE_LIBEVDEV
	help
	  Emulated input protocol library (with liboeffis); mutter's input
	  capture and remote desktop paths use it.

	  https://gitlab.freedesktop.org/libinput/libei
```

## external/package/libfreeaptx/Config.in
```kconfig
config BR2_PACKAGE_LIBFREEAPTX
	bool "libfreeaptx"
	depends on !BR2_STATIC_LIBS
	help
	  Free implementation of the aptX and aptX HD Bluetooth audio
	  codecs; PipeWire's bluez plugin detects and uses it.

	  https://github.com/iamthehorker/libfreeaptx
```

## external/package/libgtop/Config.in
```kconfig
config BR2_PACKAGE_LIBGTOP
	bool "libgtop"
	depends on BR2_USE_WCHAR # libglib2
	depends on BR2_TOOLCHAIN_HAS_THREADS # libglib2
	depends on BR2_USE_MMU # libglib2
	select BR2_PACKAGE_LIBGLIB2
	help
	  System-monitoring library (processes, memory, disks); the
	  console and control center read it.

	  https://gitlab.gnome.org/GNOME/libgtop
```

## external/package/libgusb/Config.in
```kconfig
config BR2_PACKAGE_LIBGUSB
	bool "libgusb"
	depends on BR2_USE_MMU
	select BR2_PACKAGE_LIBUSB
	select BR2_PACKAGE_JSON_GLIB
	help
	  GObject wrapper around libusb; colord's hardware sensors go
	  through it.

	  https://github.com/hughsie/libgusb
```

## external/package/libgweather/Config.in
```kconfig
config BR2_PACKAGE_LIBGWEATHER
	bool "libgweather"
	depends on BR2_USE_MMU
	select BR2_PACKAGE_LIBSOUP3
	select BR2_PACKAGE_JSON_GLIB
	select BR2_PACKAGE_LIBXML2
	select BR2_PACKAGE_TZDATA
	help
	  Weather data library; a gnome-settings-daemon build
	  dependency.

	  https://gitlab.gnome.org/GNOME/libgweather
```

## external/package/liblc3/Config.in
```kconfig
config BR2_PACKAGE_LIBLC3
	bool "liblc3"
	depends on !BR2_STATIC_LIBS
	help
	  The LC3 codec (Bluetooth LE Audio). PipeWire only uses it
	  once the accompanying buildroot pipewire patch is applied -
	  see external/patches/buildroot/README.md.

	  https://github.com/google/liblc3
```

## external/package/liblcf/Config.in
```kconfig
config BR2_PACKAGE_LIBLCF
	bool "liblcf"
	select BR2_PACKAGE_EXPAT
	select BR2_PACKAGE_ICU
	select BR2_PACKAGE_INIH
	help
	  liblcf: library for reading and writing the RPG Maker
	  2000/2003 data formats (LCF, LDB, LMT, LMU) plus their XML
	  serialisation. The data layer of the EasyRPG player.

	  https://github.com/EasyRPG/liblcf
```

## external/package/libldac/Config.in
```kconfig
config BR2_PACKAGE_LIBLDAC
	bool "libldac"
	depends on !BR2_STATIC_LIBS
	help
	  LDAC Bluetooth audio encoder (the open ldacBT packaging of
	  Sony's codec); PipeWire's bluez plugin detects and uses it
	  for LDAC-capable headphones.

	  https://github.com/EHfive/ldacBT
```

## external/package/libnma/Config.in
```kconfig
config BR2_PACKAGE_LIBNMA
	bool "libnma"
	depends on BR2_PACKAGE_LIBGTK4
	select BR2_PACKAGE_NETWORK_MANAGER
	help
	  NetworkManager UI library (the GTK 4 build); the control
	  center's network panel requires it.

	  https://gitlab.gnome.org/GNOME/libnma
```

## external/package/libnotify/Config.in
```kconfig
config BR2_PACKAGE_LIBNOTIFY
	bool "libnotify"
	depends on BR2_PACKAGE_LIBGTK3
	select BR2_PACKAGE_GDK_PIXBUF
	help
	  Desktop notification client library (org.freedesktop.
	  Notifications); GNOME's settings daemon and many applications
	  send their notifications through it.

	  https://gitlab.gnome.org/GNOME/libnotify
```

## external/package/libportal/Config.in
```kconfig
config BR2_PACKAGE_LIBPORTAL
	bool "libportal"
	depends on BR2_PACKAGE_LIBGTK4
	select BR2_PACKAGE_XDG_DESKTOP_PORTAL
	help
	  Client library for the xdg-desktop portals with a GTK 4
	  backend; epiphany requires it.

	  https://github.com/flatpak/libportal
```

## external/package/librest/Config.in
```kconfig
config BR2_PACKAGE_LIBREST
	bool "librest"
	depends on BR2_USE_WCHAR # libglib2
	depends on BR2_TOOLCHAIN_HAS_THREADS # libglib2
	depends on BR2_USE_MMU # libglib2
	select BR2_PACKAGE_LIBGLIB2
	select BR2_PACKAGE_LIBSOUP3
	select BR2_PACKAGE_JSON_GLIB
	help
	  RESTful web API client library; gnome-online-accounts talks
	  its providers through it.

	  https://gitlab.gnome.org/GNOME/librest
```

## external/package/libretro-dosbox-pure/Config.in
```kconfig
config BR2_PACKAGE_LIBRETRO_DOSBOX_PURE
	bool "libretro-dosbox-pure"
	depends on BR2_PACKAGE_RETROARCH
	help
	  DOSBox Pure libretro core: DOS games, tuned for ease of use
	  (loads .zip and .dosz archives directly, save states,
	  rewind). C++ with a plain Makefile and no external
	  dependencies - SDL is stubbed out for the libretro build.

	  https://github.com/schellingb/dosbox-pure
```

## external/package/libretro-easyrpg/Config.in
```kconfig
config BR2_PACKAGE_LIBRETRO_EASYRPG
	bool "libretro-easyrpg"
	depends on BR2_PACKAGE_RETROARCH
	select BR2_PACKAGE_LIBLCF
	select BR2_PACKAGE_SDL2
	select BR2_PACKAGE_ZLIB
	select BR2_PACKAGE_FMT
	select BR2_PACKAGE_LIBPNG
	select BR2_PACKAGE_FREETYPE
	select BR2_PACKAGE_MPG123
	select BR2_PACKAGE_LIBVORBIS
	select BR2_PACKAGE_OPUSFILE
	select BR2_PACKAGE_PIXMAN
	select BR2_PACKAGE_SPEEXDSP
	help
	  EasyRPG Player libretro core: plays RPG Maker 2000 and 2003
	  games (RPG_RT.ldb projects). The engine reimplementation,
	  not an emulator - games run natively at full speed.

	  https://github.com/EasyRPG/Player
```

## external/package/libretro-fceumm/Config.in
```kconfig
config BR2_PACKAGE_LIBRETRO_FCEUMM
	bool "libretro-fceumm"
	depends on BR2_PACKAGE_RETROARCH
	help
	  FCEUmm libretro core: NES / Famicom emulation. The first core
	  wired into the image, chosen for its plain-Makefile build and
	  tiny footprint; further systems follow the same pattern.

	  https://github.com/libretro/libretro-fceumm
```

## external/package/libretro-gambatte/Config.in
```kconfig
config BR2_PACKAGE_LIBRETRO_GAMBATTE
	bool "libretro-gambatte"
	depends on BR2_PACKAGE_RETROARCH
	help
	  Gambatte libretro core: Game Boy / Game Boy Color emulation
	  with a focus on accuracy, the standard GBC core.

	  https://github.com/libretro/gambatte-libretro
```

## external/package/libretro-lutro/Config.in
```kconfig
config BR2_PACKAGE_LIBRETRO_LUTRO
	bool "libretro-lutro"
	depends on BR2_PACKAGE_RETROARCH
	help
	  Lutro libretro core: a Lua game framework implementing a
	  subset of the LOVE API on libretro. Runs .lutro bundles and
	  plain Lua games. All dependencies (lua, physfs, ogg/vorbis,
	  zlib) are vendored in-tree.

	  https://github.com/libretro/libretro-lutro
```

## external/package/libretro-mgba/Config.in
```kconfig
config BR2_PACKAGE_LIBRETRO_MGBA
	bool "libretro-mgba"
	depends on BR2_PACKAGE_RETROARCH
	select BR2_PACKAGE_LIBZIP
	select BR2_PACKAGE_LIBPNG
	select BR2_PACKAGE_ZLIB
	help
	  mGBA libretro core: Game Boy Advance emulation (and Game
	  Boy/Game Boy Color via its GB mode), the accuracy/speed
	  sweet spot for GBA.

	  https://github.com/mgba-emu/mgba
```

## external/package/libretro-minivmac/Config.in
```kconfig
config BR2_PACKAGE_LIBRETRO_MINIVMAC
	bool "libretro-minivmac"
	depends on BR2_PACKAGE_RETROARCH
	help
	  Mini vMac libretro core: early Macintosh (128K/512K/Plus/II)
	  emulation. Needs the machine ROM (vMac.ROM) next to the disk
	  images in the system directory.

	  https://github.com/libretro/libretro-minivmac
```

## external/package/libretro-mu/Config.in
```kconfig
config BR2_PACKAGE_LIBRETRO_MU
	bool "libretro-mu"
	depends on BR2_PACKAGE_RETROARCH
	help
	  Mu libretro core: Palm OS handheld emulation (Palm m515,
	  OS 4/5 era). Needs the Palm OS ROM (palmos41-en-m515.rom)
	  in the system directory.

	  https://github.com/libretro/Mu
```
