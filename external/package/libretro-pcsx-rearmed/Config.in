## external/package/libretro-pcsx-rearmed/Config.in
```kconfig
config BR2_PACKAGE_LIBRETRO_PCSX_REARMED
	bool "libretro-pcsx-rearmed"
	depends on BR2_PACKAGE_RETROARCH
	select BR2_PACKAGE_ZLIB
	help
	  PCSX-ReARMed libretro core: PlayStation 1 emulation. Ships a
	  dynarec for every target this image builds: lightrec on
	  x86_64, the ari64 backend on aarch64, the classic ReARMed
	  recompiler on 32-bit ARM.

	  https://github.com/libretro/pcsx_rearmed
```

## external/package/libretro-scummvm/Config.in
```kconfig
config BR2_PACKAGE_LIBRETRO_SCUMMVM
	bool "libretro-scummvm"
	depends on BR2_PACKAGE_RETROARCH
	help
	  ScummVM libretro core: point-and-click adventure engines
	  (SCUMM, AGI, SCI, and the rest of ScummVM's engine
	  collection) inside RetroArch. Games launch from a .scummvm
	  file containing the game id.

	  https://github.com/libretro/scummvm
```

## external/package/libretro-snes9x/Config.in
```kconfig
config BR2_PACKAGE_LIBRETRO_SNES9X
	bool "libretro-snes9x"
	depends on BR2_PACKAGE_RETROARCH
	help
	  Snes9x libretro core: Super Nintendo / Super Famicom
	  emulation, the current mainline Snes9x. Note the Snes9x
	  license permits non-commercial use only.

	  https://github.com/libretro/snes9x
```

## external/package/libwacom/Config.in
```kconfig
config BR2_PACKAGE_LIBWACOM
	bool "libwacom"
	depends on BR2_PACKAGE_HAS_UDEV
	select BR2_PACKAGE_LIBGUDEV
	select BR2_PACKAGE_LIBEVDEV
	help
	  Tablet description library; mutter and gnome-settings-daemon
	  require it on Linux even without a tablet present.

	  https://github.com/linuxwacom/libwacom
```

## external/package/libwnck/Config.in
```kconfig
config BR2_PACKAGE_LIBWNCK
	bool "libwnck"
	depends on BR2_PACKAGE_LIBGTK3
	select BR2_PACKAGE_STARTUP_NOTIFICATION
	select BR2_PACKAGE_XLIB_LIBXRES
	help
	  Window Navigator Construction Kit: the window-list/tasklist
	  library the XFCE window manager, panel and desktop build on
	  (X11 only).

	  https://gitlab.gnome.org/GNOME/libwnck
```

## external/package/libxfce4ui/Config.in
```kconfig
config BR2_PACKAGE_LIBXFCE4UI
	bool "libxfce4ui"
	depends on BR2_PACKAGE_LIBGTK3
	select BR2_PACKAGE_LIBXFCE4UTIL
	select BR2_PACKAGE_XFCONF
	select BR2_PACKAGE_STARTUP_NOTIFICATION
	help
	  GTK widget library shared by the XFCE applications.

	  https://docs.xfce.org/
```

## external/package/libxfce4util/Config.in
```kconfig
config BR2_PACKAGE_LIBXFCE4UTIL
	bool "libxfce4util"
	depends on BR2_USE_WCHAR # libglib2
	depends on BR2_TOOLCHAIN_HAS_THREADS # libglib2
	depends on BR2_USE_MMU # libglib2
	select BR2_PACKAGE_LIBGLIB2
	help
	  Base utility library of the XFCE desktop.

	  https://docs.xfce.org/
```

## external/package/localsearch/Config.in
```kconfig
config BR2_PACKAGE_LOCALSEARCH
	bool "localsearch"
	depends on BR2_PACKAGE_TINYSPARQL
	select BR2_PACKAGE_LIBSECCOMP
	help
	  File indexer over tinysparql (formerly tracker-miners);
	  nautilus search uses its index when present.

	  https://gitlab.gnome.org/GNOME/localsearch
```

## external/package/love/Config.in
```kconfig
config BR2_PACKAGE_LOVE
	bool "love"
	depends on BR2_PACKAGE_LUAJIT_ARCH_SUPPORTS
	select BR2_PACKAGE_LUAJIT_EMBED
	select BR2_PACKAGE_SDL2
	select BR2_PACKAGE_SDL2_OPENGL if BR2_PACKAGE_HAS_LIBGL
	select BR2_PACKAGE_OPENAL
	select BR2_PACKAGE_FREETYPE
	select BR2_PACKAGE_LIBMODPLUG
	select BR2_PACKAGE_MPG123
	select BR2_PACKAGE_LIBVORBIS
	select BR2_PACKAGE_LIBOGG
	select BR2_PACKAGE_LIBTHEORA
	select BR2_PACKAGE_ZLIB
	help
	  LOVE: the Lua 2D game framework. Runs .love game bundles
	  (zipped Lua projects) with LuaJIT; graphics through
	  SDL2/OpenGL, audio through OpenAL.

	  https://love2d.org
```

## external/package/luajit-embed/Config.in
```kconfig
config BR2_PACKAGE_LUAJIT_EMBED
	bool "luajit-embed"
	depends on BR2_PACKAGE_LUAJIT_ARCH_SUPPORTS
	depends on !BR2_STATIC_LIBS # dlopen
	help
	  LuaJIT built as an embeddable library rather than as the
	  system Lua interpreter.

	  Buildroot's luajit package registers itself as the provider
	  of the "luainterpreter" virtual package and symlinks
	  /usr/bin/lua to itself, so it cannot coexist with lua - the
	  build stops with a configuration error if both are selected.
	  That is a problem for this image, which needs both:
	  WirePlumber requires the Lua 5.4 ABI, while love and
	  solarus-engine require the LuaJIT (Lua 5.1) API.

	  This package builds the same sources and installs the
	  library, headers and the luajit binary, but claims neither
	  the virtual package nor the /usr/bin/lua name. Engines link
	  it directly; lua stays the system interpreter.

	  https://luajit.org
```

## external/package/lutris/Config.in
```kconfig
config BR2_PACKAGE_LUTRIS
	bool "lutris"
	depends on BR2_PACKAGE_PYTHON3
	depends on BR2_PACKAGE_LIBGTK3
	select BR2_PACKAGE_PYTHON_GOBJECT
	select BR2_PACKAGE_PYTHON_REQUESTS
	select BR2_PACKAGE_PYTHON_PYYAML
	select BR2_PACKAGE_PYTHON_PILLOW
	select BR2_PACKAGE_PYTHON_DBUS_NEXT
	help
	  Lutris: the open game launcher. One library across sources -
	  its own installer scripts, GOG, itch.io, and the emulators
	  and Wine builds it manages. A GTK 3 Python application; the
	  GTK typelibs it drives come from gobject-introspection,
	  which the desktop frontends already build.

	  https://lutris.net

comment "lutris needs python3 and gtk3"
	depends on !BR2_PACKAGE_PYTHON3 || !BR2_PACKAGE_LIBGTK3
```

## external/package/media-automount/Config.in
```kconfig
config BR2_PACKAGE_MEDIA_AUTOMOUNT
	bool "media-automount"
	depends on BR2_PACKAGE_HAS_UDEV
	help
	  Automount removable drives to /media/<label> with a udev rule
	  and a small helper - the embedded tier of automounting, for
	  images without a desktop volume monitor. GNOME images get the
	  desktop tier through gvfs/udisks instead.
```

## external/package/miyoo-ctl/Config.in
```kconfig
config BR2_PACKAGE_MIYOO_CTL
	bool "miyoo-ctl"
	help
	  Hardware control CLI for the Allwinner suniv handheld family:
	  volume, rumble, panel/keypad/layout revision selection -
	  the userland side of the family kernel's miyoo modules, used
	  by scripts and by miyoo-daemon's hotkeys.

	  https://github.com/MiyooCFW/miyooctl
```

## external/package/miyoo-daemon/Config.in
```kconfig
config BR2_PACKAGE_MIYOO_DAEMON
	bool "miyoo-daemon"
	help
	  Hardware daemon for the Allwinner suniv handheld family
	  (BittBoy, PocketGo, PowKiddy Q90/V90/Q20): battery-low
	  warnings (screen flash or rumble) and the RESET/HOME hotkey
	  combos, talking to the family kernel's miyoo_kbd driver.

	  https://github.com/MiyooCFW/daemon
```

## external/package/modemmanager/Config.in
```kconfig
config BR2_PACKAGE_MODEMMANAGER
	bool "modemmanager"
	depends on BR2_PACKAGE_HAS_UDEV
	select BR2_PACKAGE_LIBGUDEV
	help
	  ModemManager daemon and libmm-glib, built without qmi/mbim;
	  here chiefly because the control center's network code links
	  libmm-glib.

	  https://modemmanager.org
```

## external/package/mozjs128/Config.in
```kconfig
config BR2_PACKAGE_MOZJS128
	bool "mozjs128"
	depends on BR2_INSTALL_LIBSTDCPP
	depends on BR2_TOOLCHAIN_HAS_THREADS
	depends on BR2_USE_WCHAR
	depends on BR2_USE_MMU
	depends on !BR2_STATIC_LIBS
	depends on BR2_PACKAGE_HOST_RUSTC_TARGET_ARCH_SUPPORTS
	select BR2_PACKAGE_ZLIB
	help
	  SpiderMonkey 128 ESR, Mozilla's JavaScript engine, built
	  standalone from the Firefox ESR source. gjs - and through it
	  gnome-shell - runs on it.

	  https://spidermonkey.dev
```

## external/package/mutter/Config.in
```kconfig
config BR2_PACKAGE_MUTTER
	bool "mutter"
	depends on BR2_PACKAGE_LIBGTK4 # x11 frames client
	depends on BR2_PACKAGE_HAS_UDEV
	select BR2_PACKAGE_GRAPHENE
	select BR2_PACKAGE_LIBEI
	select BR2_PACKAGE_LIBDISPLAY_INFO
	select BR2_PACKAGE_COLORD
	select BR2_PACKAGE_LCMS2
	select BR2_PACKAGE_LIBINPUT
	select BR2_PACKAGE_LIBDRM
	select BR2_PACKAGE_LIBXKBCOMMON
	select BR2_PACKAGE_WAYLAND
	select BR2_PACKAGE_WAYLAND_PROTOCOLS
	select BR2_PACKAGE_PIPEWIRE
	select BR2_PACKAGE_LIBWACOM
	select BR2_PACKAGE_ELOGIND
	select BR2_PACKAGE_GSETTINGS_DESKTOP_SCHEMAS
	select BR2_PACKAGE_XKEYBOARD_CONFIG
	help
	  GNOME's Wayland compositor and window manager; gnome-shell is
	  a mutter client/plugin. Runs natively on KMS/DRM through its
	  own backend (no X server), with Xwayland for X11 apps.

	  https://gitlab.gnome.org/GNOME/mutter
```

## external/package/nautilus/Config.in
```kconfig
config BR2_PACKAGE_NAUTILUS
	bool "nautilus"
	depends on BR2_PACKAGE_LIBGTK4
	select BR2_PACKAGE_LIBADWAITA
	select BR2_PACKAGE_GNOME_AUTOAR
	select BR2_PACKAGE_GEXIV2
	select BR2_PACKAGE_TINYSPARQL
	select BR2_PACKAGE_GNOME_DESKTOP
	select BR2_PACKAGE_LOCALSEARCH # runtime search index
	help
	  Files (nautilus), the GNOME file manager.

	  https://apps.gnome.org/Nautilus/
```

## external/package/python-pygame2/Config.in
```kconfig
config BR2_PACKAGE_PYTHON_PYGAME2
	bool "python-pygame2"
	depends on BR2_PACKAGE_PYTHON3
	select BR2_PACKAGE_SDL2
	select BR2_PACKAGE_SDL2_IMAGE
	select BR2_PACKAGE_SDL2_MIXER
	select BR2_PACKAGE_SDL2_TTF
	select BR2_PACKAGE_LIBPNG
	select BR2_PACKAGE_JPEG
	help
	  pygame: the Python game library on SDL2. Lets the image run
	  plain-Python games (a .py entry point) without a build step.

	  https://www.pygame.org
```

## external/package/retroarch/Config.in
```kconfig
config BR2_PACKAGE_RETROARCH
	bool "retroarch"
	depends on BR2_INSTALL_LIBSTDCPP
	depends on BR2_TOOLCHAIN_HAS_THREADS
	depends on !BR2_STATIC_LIBS
	depends on BR2_PACKAGE_HAS_LIBGL || BR2_PACKAGE_HAS_LIBGLES
	select BR2_PACKAGE_ZLIB
	select BR2_PACKAGE_FREETYPE
	select BR2_PACKAGE_ALSA_LIB
	select BR2_PACKAGE_LIBXKBCOMMON
	help
	  The reference libretro frontend: loads emulator cores
	  (*_libretro.so) and gives them video, audio, input and
	  savestate plumbing. EmulationStation launches it with the
	  core matching the selected game's system.

	  Cores are separate packages (libretro-*); the frontend alone
	  runs nothing.

	  https://www.retroarch.com

comment "retroarch needs OpenGL(ES) and a toolchain w/ C++, threads, dynamic library"
	depends on !BR2_PACKAGE_HAS_LIBGL && !BR2_PACKAGE_HAS_LIBGLES
```

## external/package/rocknix-abl/Config.in
```kconfig
config BR2_PACKAGE_ROCKNIX_ABL
	bool "rocknix-abl"
	depends on BR2_aarch64
	help
	  Signed Android-bootloader (abl) payloads for the Qualcomm
	  handhelds (SM6115/SM8250/SM8550/SM8650/SM8750): the flashable
	  bootloader stage that chainloads the UEFI boot path these
	  boards use. Installed under /usr/share/bootloader for the
	  device flashing flow, not executed on the image itself.

	  https://github.com/ROCKNIX/abl
```

## external/package/sdl3/Config.in
```kconfig
config BR2_PACKAGE_SDL3
	bool "sdl3"
	depends on !BR2_STATIC_LIBS # dlopen
	depends on BR2_TOOLCHAIN_HAS_THREADS
	help
	  Simple DirectMedia Layer 3 (SDL3) is a cross-platform library
	  for low level access to audio, keyboard, mouse, joystick and
	  graphics hardware.

	  SDL3 is not packaged by Buildroot (which ships SDL2 only), so
	  this package provides it.

	  https://www.libsdl.org/

if BR2_PACKAGE_SDL3

config BR2_PACKAGE_SDL3_WAYLAND
	bool "Wayland video driver"
	default y
	depends on BR2_PACKAGE_WAYLAND
	select BR2_PACKAGE_LIBXKBCOMMON
	select BR2_PACKAGE_WAYLAND_PROTOCOLS
	help
	  Enable the Wayland video driver.

comment "Wayland video driver needs wayland"
	depends on !BR2_PACKAGE_WAYLAND

config BR2_PACKAGE_SDL3_KMSDRM
	bool "KMS/DRM video driver"
	depends on BR2_PACKAGE_HAS_LIBGBM
	depends on BR2_PACKAGE_HAS_LIBEGL
	select BR2_PACKAGE_LIBDRM
	help
	  Enable the KMS/DRM video driver, for rendering directly to a
	  display with no compositor.

comment "KMS/DRM video driver needs a GBM and EGL provider"
	depends on !BR2_PACKAGE_HAS_LIBGBM || !BR2_PACKAGE_HAS_LIBEGL

config BR2_PACKAGE_SDL3_X11
	bool "X11 video driver"
	depends on BR2_PACKAGE_XORG7
	select BR2_PACKAGE_XLIB_LIBX11
	select BR2_PACKAGE_XLIB_LIBXEXT
	help
	  Enable the X11 video driver.

comment "X11 video driver needs X.org"
	depends on !BR2_PACKAGE_XORG7

config BR2_PACKAGE_SDL3_OPENGLES
	bool "OpenGL ES support"
	default y
	depends on BR2_PACKAGE_HAS_LIBGLES
	help
	  Enable OpenGL ES rendering.

comment "OpenGL ES support needs an OpenGL ES provider"
	depends on !BR2_PACKAGE_HAS_LIBGLES

config BR2_PACKAGE_SDL3_OPENGL
	bool "OpenGL support"
	depends on BR2_PACKAGE_HAS_LIBGL
	help
	  Enable desktop OpenGL rendering.

comment "OpenGL support needs an OpenGL provider"
	depends on !BR2_PACKAGE_HAS_LIBGL

config BR2_PACKAGE_SDL3_ALSA
	bool "ALSA audio"
	depends on BR2_PACKAGE_ALSA_LIB
	help
	  Enable the ALSA audio driver.

comment "ALSA audio needs alsa-lib"
	depends on !BR2_PACKAGE_ALSA_LIB

config BR2_PACKAGE_SDL3_TESTS
	bool "build test programs"
	help
	  Build and install the SDL3 test programs, useful for checking
	  the video and audio drivers on target.

endif
```

## external/package/shaderc/Config.in
```kconfig
config BR2_PACKAGE_SHADERC
	bool "shaderc"
	depends on BR2_INSTALL_LIBSTDCPP
	depends on !BR2_STATIC_LIBS
	select BR2_PACKAGE_SPIRV_TOOLS
	select BR2_PACKAGE_SPIRV_HEADERS
	help
	  Google's shader-compilation library over glslang: the
	  libshaderc API Vulkan consumers (RetroArch's vulkan video
	  driver among them) use for runtime shader compilation.

	  https://github.com/google/shaderc
```
