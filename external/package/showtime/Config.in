## external/package/showtime/Config.in
```kconfig
config BR2_PACKAGE_SHOWTIME
	bool "showtime"
	depends on BR2_PACKAGE_LIBGTK4
	select BR2_PACKAGE_LIBADWAITA
	select BR2_PACKAGE_PYTHON3
	select BR2_PACKAGE_PYTHON_GOBJECT
	select BR2_PACKAGE_GST1_PLUGINS_BASE
	select BR2_PACKAGE_GST1_PLUGINS_GOOD
	help
	  Showtime, the GNOME video player (Python/GTK 4 over
	  GStreamer) - chosen over Totem, whose libhandy/grilo stack
	  this image does not carry.

	  https://apps.gnome.org/Showtime/
```

## external/package/solarus-engine/Config.in
```kconfig
config BR2_PACKAGE_SOLARUS_ENGINE
	bool "solarus-engine"
	depends on BR2_INSTALL_LIBSTDCPP
	depends on BR2_PACKAGE_LUAJIT_ARCH_SUPPORTS
	depends on !BR2_STATIC_LIBS # SDL2
	depends on BR2_PACKAGE_HAS_LIBGL || BR2_PACKAGE_HAS_LIBGLES
	select BR2_PACKAGE_LUAJIT_EMBED
	select BR2_PACKAGE_GLM
	select BR2_PACKAGE_LIBMODPLUG
	select BR2_PACKAGE_LIBOGG
	select BR2_PACKAGE_LIBVORBIS
	select BR2_PACKAGE_LIBPNG
	select BR2_PACKAGE_OPENAL
	select BR2_PACKAGE_PHYSFS
	select BR2_PACKAGE_SDL2
	select BR2_PACKAGE_SDL2_IMAGE
	select BR2_PACKAGE_SDL2_TTF
	help
	  Solarus: a free ARPG (Zelda-like) game engine scripted in
	  Lua. Runs .solarus quest packages via solarus-run.

	  Same source and options as Buildroot's solarus package, but
	  linked against LuaJIT directly: Solarus quests are Lua 5.1
	  only, and Buildroot's package requires the system-wide Lua
	  provider to be 5.1 - impossible here, since WirePlumber
	  holds it at 5.4. Engines embed their own interpreter, so
	  the two coexist.

	  https://www.solarus-games.org
```

## external/package/sound-open-firmware/Config.in
```kconfig
config BR2_PACKAGE_SOUND_OPEN_FIRMWARE
	bool "sound-open-firmware"
	help
	  Signed Sound Open Firmware binaries for DSP-routed audio
	  (Intel and MediaTek - the MT8183 Chromebooks' ADSP among
	  them). Firmware only; the topology data comes from
	  alsa-topology-conf.

	  https://github.com/thesofproject/sof-bin
```

## external/package/steam/Config.in
```kconfig
config BR2_PACKAGE_STEAM
	bool "steam"
	depends on BR2_x86_64 || BR2_aarch64
	depends on BR2_TOOLCHAIN_USES_GLIBC
	select BR2_PACKAGE_BASH # /usr/bin/steam is a bash script
	select BR2_PACKAGE_XWAYLAND # Steam's UI is X11
	# Every Steam binary is x86: the 32-bit bootstrap needs box86 (built
	# in the armv7 companion, merged by post-build-lib32.sh), the client
	# and games need box64.
	select BR2_PACKAGE_BOX64 if BR2_aarch64
	help
	  Valve's Steam client bootstrap.

	  This installs only the launcher (steam-launcher .deb). The Steam
	  client itself, and the Steam Runtime that provides most of its
	  libraries, are downloaded into the user's home directory on first
	  launch, so Steam needs network access the first time it runs.

	  There is no native ARM64 Steam: the launcher's own
	  detect_platform() hard-codes "ubuntu12_32" ("the only platform
	  we have a bootstrap for"), the .deb is published for amd64
	  only, and the bootstrap it unpacks is a 32-bit i386 binary.

	  So on x86_64 the client runs natively, and on ARM64 every part
	  of it is translated: the 32-bit bootstrap through box86, the
	  64-bit client and games through box64, dispatched by the
	  binfmt_misc handlers S07binfmt registers. box86 is built in the
	  armv7 companion, so an ARM64 image needs that companion merged
	  (the "lib32" profile / SWIFT_LINUX_LIB32_ROOT) or Steam cannot
	  start at all. x86_64 images need the i386 companion for the same
	  bootstrap. Both also need a running X11/XWayland session.

	  Steam is proprietary; it is not redistributed in the image sources.

	  https://store.steampowered.com/about/

comment "steam needs a glibc toolchain"
	depends on BR2_x86_64 || BR2_aarch64
	depends on !BR2_TOOLCHAIN_USES_GLIBC
```

## external/package/swaywm/Config.in
```kconfig
config BR2_PACKAGE_SWAYWM
	bool "swaywm (sway, systemd-free)"
	depends on !BR2_STATIC_LIBS # wlroots
	depends on BR2_TOOLCHAIN_HAS_THREADS # pango, wlroots
	depends on BR2_PACKAGE_HAS_LIBEGL # wlroots
	depends on BR2_PACKAGE_HAS_LIBGLES # wlroots
	depends on BR2_PACKAGE_HAS_LIBGBM # wlroots
	depends on BR2_PACKAGE_HAS_UDEV # wlroots
	depends on BR2_TOOLCHAIN_HAS_SYNC_4 # json-c, pango
	depends on BR2_USE_WCHAR # pango
	depends on BR2_USE_MMU # pango
	depends on BR2_INSTALL_LIBSTDCPP # pango
	depends on BR2_TOOLCHAIN_GCC_AT_LEAST_4_9 # pango
	select BR2_PACKAGE_WLROOTS
	select BR2_PACKAGE_BASU
	select BR2_PACKAGE_JSON_C
	select BR2_PACKAGE_PCRE2
	select BR2_PACKAGE_CAIRO
	select BR2_PACKAGE_CAIRO_PNG
	select BR2_PACKAGE_PANGO
	select BR2_PACKAGE_XKEYBOARD_CONFIG # runtime
	help
	  i3-compatible Wayland compositor.

	  This is the same compositor Buildroot packages as "sway", built
	  against basu instead of libsystemd for its sd-bus provider, so it
	  does not drag in systemd. Buildroot's own sway package hardcodes
	  -Dsd-bus-provider=libsystemd and therefore depends on systemd;
	  enable this one instead of that.

	  The default sway config uses foot as the terminal, so select the
	  foot package as well.

	  https://github.com/swaywm/sway

if BR2_PACKAGE_SWAYWM

config BR2_PACKAGE_SWAYWM_SWAYBAR
	bool "swaybar"
	select BR2_PACKAGE_DEJAVU # runtime, default font
	help
	  Build swaybar, the status bar.

endif

comment "swaywm needs an OpenGL ES/EGL/GBM provider, udev and a toolchain w/ threads, wchar, C++"
	depends on !BR2_PACKAGE_HAS_LIBEGL || !BR2_PACKAGE_HAS_LIBGLES || \
		!BR2_PACKAGE_HAS_LIBGBM || !BR2_PACKAGE_HAS_UDEV || \
		!BR2_TOOLCHAIN_HAS_THREADS || !BR2_USE_WCHAR || \
		!BR2_INSTALL_LIBSTDCPP || BR2_STATIC_LIBS
```

## external/package/swift-initramfs/Config.in
```kconfig
config BR2_PACKAGE_SWIFT_INITRAMFS
	bool "swift-initramfs"
	help
	  Minimal initramfs for the A/B images: a static busybox and an
	  init that resolves root=PARTUUID= via sysfs, waits for slow
	  media, mounts the slot read-only and switch_roots - dropping
	  to a rescue shell instead of a kernel panic when the root
	  device never appears. Carries no update logic: RAUC owns
	  updates. Opt-in via sdk/defconfig/boot/initramfs.config; the
	  GRUB configs load /boot/initrd only when a slot ships it.
```

## external/package/thunar/Config.in
```kconfig
config BR2_PACKAGE_THUNAR
	bool "thunar"
	depends on BR2_PACKAGE_LIBGTK3
	select BR2_PACKAGE_EXO
	select BR2_PACKAGE_LIBXFCE4UI
	help
	  The XFCE file manager.

	  https://docs.xfce.org/
```

## external/package/tinysparql/Config.in
```kconfig
config BR2_PACKAGE_TINYSPARQL
	bool "tinysparql"
	depends on BR2_USE_WCHAR # libglib2
	depends on BR2_TOOLCHAIN_HAS_THREADS # libglib2
	depends on BR2_USE_MMU # libglib2
	select BR2_PACKAGE_LIBGLIB2
	select BR2_PACKAGE_JSON_GLIB
	select BR2_PACKAGE_LIBSOUP3
	select BR2_PACKAGE_SQLITE
	select BR2_PACKAGE_ICU
	help
	  SPARQL triple store (the library formerly known as tracker);
	  nautilus queries file metadata through it.

	  https://gitlab.gnome.org/GNOME/tinysparql
```

## external/package/totem-pl-parser/Config.in
```kconfig
config BR2_PACKAGE_TOTEM_PL_PARSER
	bool "totem-pl-parser"
	depends on BR2_USE_WCHAR # libglib2
	depends on BR2_TOOLCHAIN_HAS_THREADS # libglib2
	depends on BR2_USE_MMU # libglib2
	select BR2_PACKAGE_LIBGLIB2
	select BR2_PACKAGE_LIBXML2
	select BR2_PACKAGE_LIBSOUP3
	help
	  Playlist parser library (m3u, pls, xspf); media apps share it.

	  https://gitlab.gnome.org/GNOME/totem-pl-parser
```

## external/package/udisks2/Config.in
```kconfig
config BR2_PACKAGE_UDISKS2
	bool "udisks2"
	depends on BR2_PACKAGE_HAS_UDEV
	select BR2_PACKAGE_LIBBLOCKDEV
	select BR2_PACKAGE_LIBBLOCKDEV_FS
	select BR2_PACKAGE_LIBBLOCKDEV_LOOP
	select BR2_PACKAGE_LIBBLOCKDEV_PART
	select BR2_PACKAGE_LIBBLOCKDEV_SWAP
	select BR2_PACKAGE_LIBATASMART
	select BR2_PACKAGE_LIBGUDEV
	select BR2_PACKAGE_POLKIT
	select BR2_PACKAGE_ACL
	help
	  The storage D-Bus service (org.freedesktop.UDisks2): mounting,
	  formatting, SMART; GNOME Disks is its UI.

	  https://github.com/storaged-project/udisks
```

## external/package/vte4/Config.in
```kconfig
config BR2_PACKAGE_VTE4
	bool "vte4"
	depends on BR2_PACKAGE_LIBGTK4
	depends on BR2_INSTALL_LIBSTDCPP
	select BR2_PACKAGE_PCRE2
	select BR2_PACKAGE_LZ4
	help
	  The VTE terminal widget built for GTK 4 (Buildroot's vte
	  package is the years-older GTK 3 line); gnome-console's
	  terminal is this widget.

	  https://gitlab.gnome.org/GNOME/vte
```

## external/package/wine-prebuilt/Config.in
```kconfig
config BR2_PACKAGE_WINE_PREBUILT
	bool "wine-prebuilt"
	depends on BR2_x86_64 || BR2_aarch64
	depends on BR2_TOOLCHAIN_USES_GLIBC
	help
	  Wine as an upstream-built x86-64 WoW64 binary (Kron4ek's
	  builds, the same source the reference distributions ship).
	  A prebuilt, deliberately: Buildroot's from-source wine is
	  i386-only, and a 64-bit WoW64 Wine - which runs 32-bit
	  Windows applications without any 32-bit Unix libraries - is
	  what both targets need. On x86_64 it runs natively; on
	  aarch64 the same binaries run through box64 via the binfmt
	  handlers (S07binfmt).

	  Installed self-contained under /usr/wine/prebuilt, so it
	  never collides with the i386 companion's /usr/bin/wine on
	  x86_64 images; wine-launch prefers it when present.

	  Wine itself is LGPL; the tarball is upstream's own release
	  artifact, hash-pinned.

	  https://github.com/Kron4ek/Wine-Builds

comment "wine-prebuilt needs an x86_64/aarch64 glibc toolchain"
	depends on !(BR2_x86_64 || BR2_aarch64) || !BR2_TOOLCHAIN_USES_GLIBC
```

## external/package/xdg-desktop-portal-gnome/Config.in
```kconfig
config BR2_PACKAGE_XDG_DESKTOP_PORTAL_GNOME
	bool "xdg-desktop-portal-gnome"
	depends on BR2_PACKAGE_LIBGTK4
	select BR2_PACKAGE_XDG_DESKTOP_PORTAL
	select BR2_PACKAGE_LIBADWAITA
	select BR2_PACKAGE_GNOME_DESKTOP
	help
	  The GNOME backend for xdg-desktop-portal (GTK4/libadwaita
	  dialogs, screencast via mutter).

	  https://gitlab.gnome.org/GNOME/xdg-desktop-portal-gnome
```

## external/package/xdg-desktop-portal-gtk/Config.in
```kconfig
config BR2_PACKAGE_XDG_DESKTOP_PORTAL_GTK
	bool "xdg-desktop-portal-gtk"
	depends on BR2_PACKAGE_LIBGTK3
	select BR2_PACKAGE_XDG_DESKTOP_PORTAL
	help
	  The GTK3 fallback backend for xdg-desktop-portal; covers the
	  interfaces the GNOME backend delegates.

	  https://github.com/flatpak/xdg-desktop-portal-gtk
```

## external/package/xdg-desktop-portal/Config.in
```kconfig
config BR2_PACKAGE_XDG_DESKTOP_PORTAL
	bool "xdg-desktop-portal"
	depends on BR2_USE_WCHAR # libglib2
	depends on BR2_TOOLCHAIN_HAS_THREADS # libglib2
	depends on BR2_USE_MMU # libglib2
	depends on !BR2_STATIC_LIBS
	select BR2_PACKAGE_LIBGLIB2
	select BR2_PACKAGE_JSON_GLIB
	select BR2_PACKAGE_LIBFUSE3
	select BR2_PACKAGE_PIPEWIRE
	help
	  The desktop-neutral portal frontend (file chooser,
	  screenshot, screencast D-Bus APIs); desktop-specific
	  backends implement the UI.

	  https://github.com/flatpak/xdg-desktop-portal
```

## external/package/xfce4-panel/Config.in
```kconfig
config BR2_PACKAGE_XFCE4_PANEL
	bool "xfce4-panel"
	depends on BR2_PACKAGE_LIBGTK3
	select BR2_PACKAGE_EXO
	select BR2_PACKAGE_GARCON
	select BR2_PACKAGE_LIBWNCK
	select BR2_PACKAGE_LIBXFCE4UI
	help
	  The XFCE panel (taskbar, launchers, plugins).

	  https://docs.xfce.org/
```

## external/package/xfce4-session/Config.in
```kconfig
config BR2_PACKAGE_XFCE4_SESSION
	bool "xfce4-session"
	depends on BR2_PACKAGE_LIBGTK3
	select BR2_PACKAGE_LIBWNCK
	select BR2_PACKAGE_LIBXFCE4UI
	select BR2_PACKAGE_XLIB_LIBSM
	select BR2_PACKAGE_XAPP_ICEAUTH # runtime
	help
	  The XFCE session manager; provides startxfce4.

	  https://docs.xfce.org/
```

## external/package/xfce4-settings/Config.in
```kconfig
config BR2_PACKAGE_XFCE4_SETTINGS
	bool "xfce4-settings"
	depends on BR2_PACKAGE_LIBGTK3
	select BR2_PACKAGE_EXO
	select BR2_PACKAGE_LIBXFCE4UI
	help
	  The XFCE settings daemon and dialogs (xsettings, display, input).

	  https://docs.xfce.org/
```

## external/package/xfconf/Config.in
```kconfig
config BR2_PACKAGE_XFCONF
	bool "xfconf"
	depends on BR2_USE_WCHAR # libglib2
	depends on BR2_TOOLCHAIN_HAS_THREADS # libglib2
	depends on BR2_USE_MMU # libglib2
	select BR2_PACKAGE_LIBXFCE4UTIL
	select BR2_PACKAGE_DBUS # runtime
	help
	  XFCE configuration storage daemon and library (over D-Bus).

	  https://docs.xfce.org/
```

## external/package/xfdesktop/Config.in
```kconfig
config BR2_PACKAGE_XFDESKTOP
	bool "xfdesktop"
	depends on BR2_PACKAGE_LIBGTK3
	select BR2_PACKAGE_EXO
	select BR2_PACKAGE_GARCON
	select BR2_PACKAGE_LIBWNCK
	select BR2_PACKAGE_LIBXFCE4UI
	help
	  The XFCE desktop (wallpaper, icons, root menu).

	  https://docs.xfce.org/
```

## external/package/xfwm4/Config.in
```kconfig
config BR2_PACKAGE_XFWM4
	bool "xfwm4"
	depends on BR2_PACKAGE_LIBGTK3
	select BR2_PACKAGE_LIBWNCK
	select BR2_PACKAGE_LIBXFCE4UI
	help
	  The XFCE window manager (X11), with its GL compositor.

	  https://docs.xfce.org/
```
