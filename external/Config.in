## external/Config.in
```kconfig
menu "Swift Linux packages"

source "$BR2_EXTERNAL_SWIFT_LINUX_PATH/package/alsa-topology-conf/Config.in"
source "$BR2_EXTERNAL_SWIFT_LINUX_PATH/package/alsa-ucm-conf/Config.in"
source "$BR2_EXTERNAL_SWIFT_LINUX_PATH/package/broadcom-bt-firmware/Config.in"
source "$BR2_EXTERNAL_SWIFT_LINUX_PATH/package/chromebook-ucm-conf/Config.in"
source "$BR2_EXTERNAL_SWIFT_LINUX_PATH/package/firmware-armbian/Config.in"
source "$BR2_EXTERNAL_SWIFT_LINUX_PATH/package/firmware-extra/Config.in"
source "$BR2_EXTERNAL_SWIFT_LINUX_PATH/package/firmware-rk3588/Config.in"
source "$BR2_EXTERNAL_SWIFT_LINUX_PATH/package/image-storage/Config.in"
source "$BR2_EXTERNAL_SWIFT_LINUX_PATH/package/media-automount/Config.in"
source "$BR2_EXTERNAL_SWIFT_LINUX_PATH/package/miyoo-ctl/Config.in"
source "$BR2_EXTERNAL_SWIFT_LINUX_PATH/package/miyoo-daemon/Config.in"
source "$BR2_EXTERNAL_SWIFT_LINUX_PATH/package/rocknix-abl/Config.in"
source "$BR2_EXTERNAL_SWIFT_LINUX_PATH/package/sound-open-firmware/Config.in"
source "$BR2_EXTERNAL_SWIFT_LINUX_PATH/package/swift-initramfs/Config.in"

endmenu
```

## external/package/accountsservice/Config.in
```kconfig
config BR2_PACKAGE_ACCOUNTSSERVICE
	bool "accountsservice"
	depends on BR2_USE_WCHAR # libglib2
	depends on BR2_TOOLCHAIN_HAS_THREADS # libglib2
	depends on BR2_USE_MMU # libglib2
	select BR2_PACKAGE_LIBGLIB2
	select BR2_PACKAGE_POLKIT
	select BR2_PACKAGE_ELOGIND
	help
	  org.freedesktop.Accounts: the user-account D-Bus service the
	  control center's user panel talks to; built against elogind.

	  https://www.freedesktop.org/wiki/Software/AccountsService/
```

## external/package/alsa-topology-conf/Config.in
```kconfig
config BR2_PACKAGE_ALSA_TOPOLOGY_CONF
	bool "alsa-topology-conf"
	depends on BR2_PACKAGE_ALSA_LIB
	help
	  ALSA topology configuration files, used by DSP-routed sound
	  hardware (SOF and similar) to describe its processing pipelines.

	  https://github.com/alsa-project/alsa-topology-conf
```

## external/package/alsa-ucm-conf/Config.in
```kconfig
config BR2_PACKAGE_ALSA_UCM_CONF
	bool "alsa-ucm-conf"
	depends on BR2_PACKAGE_ALSA_LIB
	depends on BR2_PACKAGE_ALSA_LIB_UCM
	help
	  ALSA Use Case Manager configuration: the per-codec routing data
	  that tells ALSA how a SoC's sound hardware is wired - speakers
	  versus headphones, which amplifier to enable, jack detection.
	  alsa-lib carries the UCM code but none of this data; without it
	  audio on most ARM devices does not route at all.

	  https://github.com/alsa-project/alsa-ucm-conf
```

## external/package/appstream/Config.in
```kconfig
config BR2_PACKAGE_APPSTREAM
	bool "appstream"
	depends on BR2_USE_WCHAR # libglib2
	depends on BR2_TOOLCHAIN_HAS_THREADS # libglib2
	depends on BR2_USE_MMU # libglib2
	depends on !BR2_STATIC_LIBS
	select BR2_PACKAGE_LIBGLIB2
	select BR2_PACKAGE_LIBXMLB
	select BR2_PACKAGE_LIBYAML
	select BR2_PACKAGE_LIBCURL
	help
	  Library for the freedesktop.org software metadata standard
	  (component metainfo); libadwaita links against it.

	  https://www.freedesktop.org/software/appstream/docs/
```

## external/package/box64/Config.in
```kconfig
config BR2_PACKAGE_BOX64
	bool "box64"
	depends on BR2_aarch64 || BR2_riscv || BR2_powerpc64le || BR2_mips64
	depends on BR2_TOOLCHAIN_USES_GLIBC
	depends on !BR2_STATIC_LIBS
	help
	  box64 runs x86_64 Linux programs on non-x86_64 64-bit systems
	  (notably ARM64) by dynamically translating the machine code and
	  redirecting well-known libraries to their native equivalents.

	  It is pointless on x86_64, where such binaries run natively, so it
	  is only offered on other 64-bit architectures.

	  https://github.com/ptitSeb/box64

comment "box64 needs a dynamic glibc toolchain"
	depends on BR2_aarch64 || BR2_riscv || BR2_powerpc64le || BR2_mips64
	depends on !BR2_TOOLCHAIN_USES_GLIBC || BR2_STATIC_LIBS
```

## external/package/box86/Config.in
```kconfig
config BR2_PACKAGE_BOX86
	bool "box86"
	depends on BR2_arm # 32-bit ARM only
	depends on BR2_TOOLCHAIN_USES_GLIBC
	depends on !BR2_STATIC_LIBS
	help
	  box86 runs 32-bit x86 Linux programs on 32-bit ARM by dynamically
	  translating the machine code and redirecting well-known libraries to
	  their native equivalents.

	  box86 is 32-bit only; use box64 for x86_64 programs on ARM64.

	  https://github.com/ptitSeb/box86

comment "box86 needs a dynamic glibc 32-bit ARM toolchain"
	depends on BR2_arm
	depends on !BR2_TOOLCHAIN_USES_GLIBC || BR2_STATIC_LIBS
```

## external/package/broadcom-bt-firmware/Config.in
```kconfig
config BR2_PACKAGE_BROADCOM_BT_FIRMWARE
	bool "broadcom-bt-firmware"
	help
	  Broadcom Bluetooth firmware (.hcd) collection, extracted from
	  Windows driver packages: the BT halves of the BCM/AP6xxx
	  combo chips on the Rockchip handhelds and ARM Chromebooks -
	  linux-firmware carries only a few of these.

	  https://github.com/winterheart/broadcom-bt-firmware
```

## external/package/chicago95/Config.in
```kconfig
config BR2_PACKAGE_CHICAGO95
	bool "chicago95"
	help
	  The Chicago95 XFCE/GTK theme: a faithful Windows 95 look for
	  xfwm4, GTK 2/3, the panel and the icon set. This package also
	  installs the xfconf channel defaults that make it the active
	  theme out of the box.

	  https://github.com/grassmunk/Chicago95
```

## external/package/chromebook-ucm-conf/Config.in
```kconfig
config BR2_PACKAGE_CHROMEBOOK_UCM_CONF
	bool "chromebook-ucm-conf"
	select BR2_PACKAGE_ALSA_UCM_CONF
	help
	  Community ALSA UCM profiles for Chromebooks (the standalone
	  branch of alsa-ucm-conf-cros): the routing data that makes
	  Chromebook speakers, microphones and jacks actually work
	  outside ChromeOS. Layered over the stock UCM set.

	  https://github.com/WeirdTreeThing/alsa-ucm-conf-cros
```

## external/package/colord-gtk/Config.in
```kconfig
config BR2_PACKAGE_COLORD_GTK
	bool "colord-gtk"
	depends on BR2_PACKAGE_LIBGTK4
	select BR2_PACKAGE_COLORD
	help
	  GTK 4 widgets for colord; the control center's color panel
	  uses them.

	  https://www.freedesktop.org/software/colord/
```

## external/package/colord/Config.in
```kconfig
config BR2_PACKAGE_COLORD
	bool "colord"
	depends on BR2_PACKAGE_HAS_UDEV
	select BR2_PACKAGE_LCMS2
	select BR2_PACKAGE_LIBGUDEV
	select BR2_PACKAGE_LIBGUSB
	select BR2_PACKAGE_SQLITE
	help
	  Color management daemon and library; mutter links libcolord
	  for its color management and night light.

	  https://www.freedesktop.org/software/colord/
```

## external/package/dconf/Config.in
```kconfig
config BR2_PACKAGE_DCONF
	bool "dconf"
	depends on BR2_USE_WCHAR # libglib2
	depends on BR2_TOOLCHAIN_HAS_THREADS # libglib2
	depends on BR2_USE_MMU # libglib2
	select BR2_PACKAGE_LIBGLIB2
	select BR2_PACKAGE_DBUS # runtime (activation)
	help
	  GNOME's low-level configuration backend: the binary settings
	  database behind GSettings for the whole GNOME stack.

	  https://gitlab.gnome.org/GNOME/dconf
```

## external/package/decibels/Config.in
```kconfig
config BR2_PACKAGE_DECIBELS
	bool "decibels"
	depends on BR2_PACKAGE_LIBGTK4
	select BR2_PACKAGE_LIBADWAITA
	depends on BR2_PACKAGE_GJS
	select BR2_PACKAGE_GST1_PLUGINS_BASE
	select BR2_PACKAGE_GST1_PLUGINS_GOOD
	help
	  Decibels, the GNOME audio player (a GJS application over
	  GStreamer).

	  https://apps.gnome.org/Decibels/
```

## external/package/elogind/Config.in
```kconfig
config BR2_PACKAGE_ELOGIND
	bool "elogind"
	depends on !BR2_STATIC_LIBS
	depends on BR2_TOOLCHAIN_HAS_THREADS
	depends on BR2_USE_MMU
	depends on BR2_PACKAGE_HAS_UDEV
	select BR2_PACKAGE_LIBCAP
	select BR2_PACKAGE_DBUS # runtime (bus activation)
	help
	  systemd-logind extracted as a standalone daemon: seat, session
	  and idle/power tracking plus the org.freedesktop.login1 D-Bus
	  API, without systemd as pid 1. The keystone for running
	  mutter/GNOME on this OpenRC image - the combination Gentoo
	  and Alpine ship in production.

	  https://github.com/elogind/elogind
```

## external/package/emulationstation/Config.in
```kconfig
config BR2_PACKAGE_EMULATIONSTATION
	bool "emulationstation"
	depends on BR2_INSTALL_LIBSTDCPP
	depends on BR2_TOOLCHAIN_HAS_THREADS
	depends on !BR2_STATIC_LIBS
	depends on BR2_PACKAGE_HAS_LIBGL || BR2_PACKAGE_HAS_LIBGLES
	select BR2_PACKAGE_SDL2
	select BR2_PACKAGE_SDL2_MIXER
	select BR2_PACKAGE_FREETYPE
	select BR2_PACKAGE_FREEIMAGE
	select BR2_PACKAGE_LIBCURL
	select BR2_PACKAGE_RAPIDJSON
	select BR2_PACKAGE_PUGIXML
	select BR2_PACKAGE_VLC
	select BR2_PACKAGE_ALSA_LIB
	select BR2_PACKAGE_LIBGLU if BR2_PACKAGE_HAS_LIBGL
	help
	  Game launcher and emulator frontend: a controller-driven interface
	  that scans a game collection, shows box art and metadata, and starts
	  the matching emulator.

	  This is the actively maintained handheld-oriented fork, which carries
	  the theming, controller handling and per-system configuration that
	  branch has accumulated.

	  https://github.com/ROCKNIX/emulationstation-next

comment "emulationstation needs OpenGL(ES) and a toolchain w/ C++, threads, dynamic library"
	depends on !BR2_PACKAGE_HAS_LIBGL && !BR2_PACKAGE_HAS_LIBGLES
```

## external/package/epiphany/Config.in
```kconfig
config BR2_PACKAGE_EPIPHANY
	bool "epiphany"
	depends on BR2_PACKAGE_LIBGTK4
	select BR2_PACKAGE_LIBADWAITA
	depends on BR2_PACKAGE_WEBKITGTK # GTK 4 API
	select BR2_PACKAGE_LIBPORTAL
	select BR2_PACKAGE_GCR4
	select BR2_PACKAGE_ISO_CODES
	select BR2_PACKAGE_NETTLE
	select BR2_PACKAGE_LIBARCHIVE
	select BR2_PACKAGE_SQLITE
	help
	  Web (epiphany), the GNOME browser on WebKitGTK's GTK 4 API -
	  Buildroot's webkitgtk builds that API when libgtk4 is in the
	  config.

	  https://apps.gnome.org/Epiphany/
```

## external/package/evolution-data-server/Config.in
```kconfig
config BR2_PACKAGE_EVOLUTION_DATA_SERVER
	bool "evolution-data-server"
	depends on BR2_PACKAGE_GCR4
	select BR2_PACKAGE_LIBICAL
	select BR2_PACKAGE_LIBSECRET
	select BR2_PACKAGE_LIBSOUP3
	select BR2_PACKAGE_JSON_GLIB
	select BR2_PACKAGE_SQLITE
	select BR2_PACKAGE_ICU
	help
	  Contact/calendar storage services. A gnome-shell hard build
	  dependency (its calendar reads libecal/libedataserver); built
	  here headless - no GTK UI, no online-accounts, no mail
	  backends beyond the local ones.

	  https://gitlab.gnome.org/GNOME/evolution-data-server
```

## external/package/exo/Config.in
```kconfig
config BR2_PACKAGE_EXO
	bool "exo"
	depends on BR2_PACKAGE_LIBGTK3
	select BR2_PACKAGE_LIBXFCE4UI
	help
	  Application/helper framework library of XFCE (URI handling, icon view).

	  https://docs.xfce.org/
```

## external/package/firmware-armbian/Config.in
```kconfig
config BR2_PACKAGE_FIRMWARE_ARMBIAN
	bool "firmware-armbian"
	help
	  The Armbian firmware blob collection: WiFi/BT and SoC blobs
	  for the ARM boards mainline linux-firmware does not cover
	  (AICSemi, Broadcom AP6xxx variants, SSV, XRadio and friends).
	  The handheld families pull it for their onboard radios.

	  https://github.com/armbian/firmware
```

## external/package/firmware-extra/Config.in
```kconfig
config BR2_PACKAGE_FIRMWARE_EXTRA
	bool "firmware-extra"
	help
	  Firmware from the upstream linux-firmware collection that
	  Buildroot's linux-firmware package offers no options for.
	  Each group below copies a curated set of files; the source
	  tarball is shared with the linux-firmware package, so
	  enabling this costs no extra download.

if BR2_PACKAGE_FIRMWARE_EXTRA

config BR2_PACKAGE_FIRMWARE_EXTRA_AMP
	bool "speaker amplifiers (Cirrus Logic, TI)"
	help
	  Smart-amp firmware for the speaker amplifiers soldered into
	  most x86 gaming handhelds: Cirrus CS35L41 and friends,
	  cs42l43, and the TI TAS25xx/TAS27xx families. Without these
	  the internal speakers stay silent while headphones work.

config BR2_PACKAGE_FIRMWARE_EXTRA_QCA_BT
	bool "Qualcomm Bluetooth (qca)"
	help
	  Bluetooth firmware for Qualcomm radios - the BT half of the
	  ath10k/ath11k/ath12k wifi parts, over USB or UART.

config BR2_PACKAGE_FIRMWARE_EXTRA_ATH_SOC
	bool "Qualcomm SoC and module wifi (ath10k/ath11k/ath12k)"
	help
	  Wifi firmware for the Qualcomm parts Buildroot has no
	  per-chip options for: WCN3990 (SDM845 phones), QCA6390
	  (SM8250 handhelds), WCN6750 (SC7180 Chromebooks) and
	  WCN7850 (wifi 7 modules).

config BR2_PACKAGE_FIRMWARE_EXTRA_AVS
	bool "Intel AVS audio DSP"
	help
	  DSP firmware for Intel's AVS audio path on Skylake-through-
	  Raptor Lake laptops and handhelds.

endif
```

## external/package/firmware-rk3588/Config.in
```kconfig
config BR2_PACKAGE_FIRMWARE_RK3588
	bool "firmware-rk3588"
	help
	  Radio firmware collected for RK3588 boards: chiefly the
	  rtl8821cs Bluetooth files the family's handhelds pair with
	  their Realtek radios; the Broadcom .hcd set comes from
	  broadcom-bt-firmware instead.

	  https://github.com/stvhay/rk3588-firmware
```

## external/package/flatpak/Config.in
```kconfig
config BR2_PACKAGE_FLATPAK
	bool "flatpak"
	depends on BR2_USE_MMU
	depends on !BR2_STATIC_LIBS
	depends on BR2_TOOLCHAIN_USES_GLIBC # user namespaces / bwrap setup
	depends on BR2_TOOLCHAIN_HAS_THREADS
	select BR2_PACKAGE_LIBOSTREE
	select BR2_PACKAGE_BUBBLEWRAP
	select BR2_PACKAGE_XDG_DBUS_PROXY
	select BR2_PACKAGE_JSON_GLIB
	select BR2_PACKAGE_APPSTREAM
	select BR2_PACKAGE_LIBXMLB
	select BR2_PACKAGE_LIBFUSE3
	select BR2_PACKAGE_LIBGPGME
	select BR2_PACKAGE_LIBSECCOMP
	select BR2_PACKAGE_ZSTD
	select BR2_PACKAGE_LIBCURL
	select BR2_PACKAGE_DBUS
	help
	  Flatpak: sandboxed application distribution for Linux
	  desktops. Applications install per-user or system-wide from
	  remotes like Flathub and run against bundled runtimes, so
	  the read-only rootfs never needs to change.

	  On this image /var/lib/flatpak is backed by /data/roms/flatpak
	  (the installation is user-supplied content, kept with the rest
	  of it), and per-app mutable state lands in /data/saves/flatpak
	  through the home skeleton's ~/.var symlink - both bound by
	  S15data, both surviving reboots and A/B updates.

	  https://flatpak.org
```

## external/package/freeimage/Config.in
```kconfig
config BR2_PACKAGE_FREEIMAGE
	bool "freeimage"
	depends on BR2_INSTALL_LIBSTDCPP
	depends on !BR2_STATIC_LIBS
	help
	  Library for the common bitmap formats (PNG, JPEG, GIF, TGA, ...).

	  Buildroot has no freeimage package; this one exists because
	  emulationstation requires it for its image handling.

	  https://freeimage.sourceforge.io

comment "freeimage needs a toolchain w/ C++, dynamic library"
	depends on BR2_STATIC_LIBS || !BR2_INSTALL_LIBSTDCPP
```

## external/package/garcon/Config.in
```kconfig
config BR2_PACKAGE_GARCON
	bool "garcon"
	depends on BR2_PACKAGE_LIBGTK3
	select BR2_PACKAGE_LIBXFCE4UI
	help
	  freedesktop.org menu library used by the XFCE panel and desktop.

	  https://docs.xfce.org/
```
